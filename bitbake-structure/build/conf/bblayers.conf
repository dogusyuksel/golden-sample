## bitbake-structure/meta-build/conf/layer.conf
```bitbake
BBPATH .= ":${LAYERDIR}"
BBFILES += "${LAYERDIR}/recipes-*/*/*.bb"
BBFILE_COLLECTIONS += "build"
BBFILE_PATTERN_build = "^${LAYERDIR}/"
BBFILE_PRIORITY_build = "1"
LAYERVERSION_build = "1"
LAYERSERIES_COMPAT_build = "bitbakeguilde"
LAYERSERIES_CORENAMES = "bitbakeguilde"
```

## bitbake-structure/meta-test/conf/layer.conf
```bitbake
BBPATH .= ":${LAYERDIR}"
BBFILES += "${LAYERDIR}/recipes-*/*/*.bb"
BBFILE_COLLECTIONS += "test"
BBFILE_PATTERN_test = "^${LAYERDIR}/"
BBFILE_PRIORITY_test = "1"
LAYERVERSION_test = "1"
LAYERSERIES_COMPAT_test = "bitbakeguilde"
LAYERSERIES_CORENAMES = "bitbakeguilde"
```

## bitbake/buildandtest/conf/bblayers.conf
```bitbake
BBPATH := "${TOPDIR}"
BBFILES ?= ""
BBLAYERS = " \
  ${TOPDIR}/../meta-build \
  ${TOPDIR}/../meta-test \
"
```

## hal/meta-hal/conf/layer.conf
```bitbake
BBPATH .= ":${LAYERDIR}"
BBFILES += "${LAYERDIR}/recipes-*/*/*.bb \
            ${LAYERDIR}/recipes-*/*/*.bbappend"
BBFILE_COLLECTIONS += "hal"
BBFILE_PATTERN_hal = "^${LAYERDIR}/"
BBFILE_PRIORITY_hal = "1"
LAYERVERSION_hal = "1"
LAYERSERIES_COMPAT_hal = "bitbakeguilde"
LAYERSERIES_CORENAMES = "bitbakeguilde"
```
